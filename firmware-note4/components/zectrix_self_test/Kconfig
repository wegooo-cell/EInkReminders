## firmware-note4/components/zectrix_self_test/Kconfig
```kconfig
menu "Zectrix hardware showcase"

config ZECTRIX_DEMO_RF_TARGET_SSID
    string "Optional Wi-Fi SSID for RF qualification"
    default ""
    help
        Leave empty for a generic scan test. Set an SSID to require three
        consecutive observations at or above the configured RSSI threshold.

config ZECTRIX_DEMO_RF_THRESHOLD_DBM
    int "RF qualification threshold (dBm)"
    range -100 -20
    default -70

config ZECTRIX_DEMO_NFC_URL
    string "Temporary NFC demonstration URL"
    default "https://www.zectrix.com"

endmenu
```

## firmware-note4/sdkconfig.defaults
```kconfig
CONFIG_ESPTOOLPY_FLASHSIZE_16MB=y
CONFIG_PARTITION_TABLE_CUSTOM=y
CONFIG_PARTITION_TABLE_CUSTOM_FILENAME="partitions.csv"
CONFIG_PARTITION_TABLE_FILENAME="partitions.csv"
CONFIG_COMPILER_CXX_EXCEPTIONS=n
CONFIG_CODEC_ES8311_SUPPORT=y
CONFIG_SPIRAM=y
CONFIG_SPIRAM_MODE_OCT=y
CONFIG_SPIRAM_SPEED_80M=y
CONFIG_SPIRAM_USE_MALLOC=y
CONFIG_PM_ENABLE=y
CONFIG_FREERTOS_USE_TICKLESS_IDLE=y
CONFIG_FREERTOS_IDLE_TIME_BEFORE_SLEEP=3
```
